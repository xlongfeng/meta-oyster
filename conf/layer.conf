## conf/layer.conf
```bitbake
# We have a conf and classes directory, add to BBPATH
BBPATH .= ":${LAYERDIR}"

# We have recipes-* directories, add to BBFILES
BBFILES += "${LAYERDIR}/recipes-*/*/*.bb \
            ${LAYERDIR}/recipes-*/*/*.bbappend"

BBFILE_COLLECTIONS += "oyster-layer"
BBFILE_PATTERN_oyster-layer = "^${LAYERDIR}/"
BBFILE_PRIORITY_oyster-layer = "5"

LAYERDEPENDS_oyster-layer = "freescale-layer"
LAYERSERIES_COMPAT_oyster-layer = "warrior"
```

## conf/machine/imx6qdlpolar.conf
```bitbake
#@TYPE: Machine
#@NAME: Oyster i.MX6QP/Q/DL Polar Device Board
#@SOC: i.MX6QP/Q/DL
#@DESCRIPTION: Machine configuration for Oyster i.MX6QP/Q/DL Polar Device Board
#@MAINTAINER: Landon Hsiao <xlongfeng@126.com>

MACHINEOVERRIDES =. "mx6:mx6q:mx6dl:"

require conf/machine/include/imx-base.inc
require conf/machine/include/tune-cortexa9.inc

PREFERRED_PROVIDER_virtual/kernel = "linux-oyster"

KERNEL_DEVICETREE = " \
	imx6dl-polar.dtb \
	imx6dl-polar-ldo.dtb \
"

KERNEL_DEVICETREE_use-mainline-bsp = " \
	imx6dl-polar.dtb \
"

PREFERRED_PROVIDER_u-boot = "u-boot-oyster"
PREFERRED_PROVIDER_virtual/bootloader = "u-boot-oyster"

UBOOT_MACHINE ?= "mx6polar_defconfig"

# Use fslc u-boot by default. See also imx-base.inc.
UBOOT_MAKE_TARGET = "all"
UBOOT_SUFFIX = "img"
SPL_BINARY = "SPL"

WKS_FILE = "oyster.wks.in"

IMAGE_FSTYPES += "tar.gz"
```
